## conf/bblayers.conf
```bitbake
# POKY_BBLAYERS_CONF_VERSION is increased each time build/conf/bblayers.conf
# changes incompatibly
POKY_BBLAYERS_CONF_VERSION = "2"

BBPATH = "${TOPDIR}"
BBFILES ?= ""

BBLAYERS ?= " \
  /home/yilmar/Documents/yocto/poky/meta \
  /home/yilmar/Documents/yocto/poky/meta-poky \
  /home/yilmar/Documents/yocto/poky/meta-yocto-bsp \
  /home/yilmar/Documents/yocto/poky/meta-openembedded/meta-oe \
  /home/yilmar/Documents/yocto/poky/meta-openembedded/meta-python \
  /home/yilmar/Documents/yocto/poky/meta-openembedded/meta-multimedia \
  /home/yilmar/Documents/yocto/poky/meta-openembedded/meta-networking \
  /home/yilmar/Documents/yocto/poky/meta-raspberrypi \
  /home/yilmar/Documents/yocto/poky/meta-proyecto2 \
  /home/yilmar/Documents/yocto/poky/meta-tensorflow-lite \
  "
```
